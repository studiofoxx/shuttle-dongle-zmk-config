## config/Kconfig.defconfig
```kconfig
if SHIELD_AIRPORT_SHUTTLE_DONGLE

config ZMK_BLE
    default y

config ZMK_USB
    default y

config ZMK_KEYBOARD_NAME
    default "Airport Shuttle"

endif

if SHIELD_AIRPORT_SHUTTLE_DONGLE

config ZMK_SPLIT
    default y

config ZMK_SPLIT_ROLE_CENTRAL
    default y

endif

if SHIELD_AIRPORT_SHUTTLE_DONGLE

config ZMK_SPLIT_BLE_CENTRAL_PERIPHERALS
    default 1

config BT_MAX_PAIRED
    default 7

config BT_MAX_CONN
    default 7

config ZMK_SPLIT_BLE_PREF_INT
    default 6

config ZMK_SPLIT_BLE_PREF_LATENCY
    default 399

config ZMK_SPLIT_BLE_PREF_TIMEOUT
    default 900

endif
```

## config/Kconfig.shield
```kconfig
config SHIELD_AIRPORT_SHUTTLE_DONGLE
    def_bool $(shields_list_contains,slicemk_ergodox_dongle)
```
